/*
 * Copyright (c) 2024 The ZMK Contributors
 *
 * SPDX-License-Identifier: MIT
 */

/ {
    behaviors {
        pms: behavior_pmw3610_setting {
            compatible = "zmk,behavior-pmw3610-setting";
            display-name = "PMW3610 Setting";
            #binding-cells = <1>;
        };
    };
};
